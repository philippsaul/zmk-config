## boards/shields/kawauso/Kconfig.defconfig
```kconfig
if SHIELD_KAWAUSO_LEFT

config ZMK_KEYBOARD_NAME
    default "Kawauso"

config ZMK_SPLIT_ROLE_CENTRAL
    default y

endif

if SHIELD_KAWAUSO_LEFT || SHIELD_KAWAUSO_RIGHT

config ZMK_SPLIT
    default y

endif
```

## boards/shields/kawauso/Kconfig.shield
```kconfig
config SHIELD_KAWAUSO_LEFT
    def_bool $(shields_list_contains,kawauso_left)
config SHIELD_KAWAUSO_RIGHT
    def_bool $(shields_list_contains,kawauso_right)
```
